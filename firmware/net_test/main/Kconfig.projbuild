## firmware/net_test/main/Kconfig.projbuild
```kconfig
menu "Nine Tails network test"
    config NT_WIFI_SSID
        string "Wi-Fi name (2.4 GHz)"
        default ""
    config NT_WIFI_PASSWORD
        string "Wi-Fi password"
        default ""
    config NT_HOST_IP
        string "Companion host address"
        default "192.168.1.42"
    config NT_HOST_PORT
        int "Companion host port"
        default 8443
endmenu
```

## firmware/net_test/sdkconfig.defaults
```kconfig
CONFIG_IDF_TARGET="esp32s3"
CONFIG_ESPTOOLPY_FLASHSIZE_16MB=y
CONFIG_ESPTOOLPY_FLASHSIZE="16MB"
CONFIG_ESP_WIFI_STATIC_RX_BUFFER_NUM=10
```

## firmware/voice_test/main/Kconfig.projbuild
```kconfig
menu "Nine Tails network test"
    config NT_WIFI_SSID
        string "Wi-Fi name (2.4 GHz)"
        default ""
    config NT_WIFI_PASSWORD
        string "Wi-Fi password"
        default ""
    config NT_HOST_IP
        string "Companion host address"
        default "192.168.1.42"
    config NT_HOST_PORT
        int "Companion host port"
        default 8443
    config NT_DEVICE_ID
        string "Device id (from the provisioning bundle)"
        default "ninetails-01"
    config NT_DEVICE_KEY_HEX
        string "Device key, 64 hex characters (SECRET, from the provisioning bundle, never committed)"
        default ""
endmenu
```

## firmware/voice_test/sdkconfig.defaults
```kconfig
CONFIG_IDF_TARGET="esp32s3"
CONFIG_ESPTOOLPY_FLASHSIZE_16MB=y
CONFIG_ESPTOOLPY_FLASHSIZE="16MB"
CONFIG_ESP_WIFI_STATIC_RX_BUFFER_NUM=10
CONFIG_ESP_SYSTEM_PANIC_PRINT_HALT=y
CONFIG_PARTITION_TABLE_CUSTOM=y
CONFIG_PARTITION_TABLE_CUSTOM_FILENAME="partitions.csv"
```
